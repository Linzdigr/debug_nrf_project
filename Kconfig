## boards/KiwiElectronics/nrf52840_quantum_v2/Kconfig.nrf52840_quantum_v2
```kconfig
config BOARD_NRF52840_QUANTUM_V2
	prompt "Kiwi Electronics nRF52840 Quantum V2 board"
	select SOC_NRF52840_QIAA
	help
	  Enable support for the Kiwi Electronics nRF52840 Quantum V2 board.
```

## drivers/display/Kconfig
```kconfig
# Copyright (c) 2021 Nordic Semiconductor ASA
# SPDX-License-Identifier: Apache-2.0

if SSD1333
rsource "ssd1333/Kconfig"
endif # SENSOR
```

## drivers/display/ssd1333/Kconfig
```kconfig
# SSD1333 display controller configuration options

# Copyright (c) 2018 Phytec Messtechnik GmbH
# SPDX-License-Identifier: Apache-2.0

config SSD1333
	bool "SSD1333 display driver"
	depends on SPI || QSPI || I2C
  default y
	help
	  Enable driver for SSD1333 display driver.

if SSD1333

config SSD1333_DEFAULT_CONTRAST
	int "SSD1333 default contrast"
	default 128
	range 0 255
	help
	  SSD1333 default contrast.

config SSD1333_REVERSE_MODE
	bool "SSD1333 reverse mode"
	help
	  SSD1333 reverse video mode.

endif # SSD1333
```

## dts/bindings/display/solomon,ssd1333.yaml
```yaml
# SPDX-License-Identifier: Apache-2.0
description: SSD1333 160x128 dot-matrix display controller on SPI bus
compatible: "solomon,ssd1333"

include: [spi-device.yaml, display-controller.yaml]

properties:
  data-ctrl-gpios:
    type: phandle-array
    required: true
    description: D/C# pin

  reset-gpios:
    type: phandle-array
    required: false
    description: RESET pin

  spi-max-frequency:
    type: int
    required: true
    description: Max SPI clock freq in Hz

  width:
    type: int
    required: true
    description: Display width in pixels

  height:
    type: int
    required: true
    description: Display height in pixels
```
